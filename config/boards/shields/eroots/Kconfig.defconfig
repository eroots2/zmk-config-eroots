## config/boards/shields/eroots/Kconfig.defconfig
```kconfig
if SHIELD_EROOTS_LEFT

config ZMK_KEYBOARD_NAME
    default "eroots"

config ZMK_SPLIT_ROLE_CENTRAL
    default y

endif

if SHIELD_EROOTS_LEFT || SHIELD_EROOTS_RIGHT

config ZMK_SPLIT
    default y

if ZMK_DISPLAY

config I2C
    default y

config SSD1306
    default y

endif # ZMK_DISPLAY

if LVGL

config LVGL_HOR_RES_MAX
	default 128

config LVGL_VER_RES_MAX
	default 32

config LVGL_VDB_SIZE
	default 64

config LVGL_DPI
	default 148

config LVGL_BITS_PER_PIXEL
	default 1

choice LVGL_COLOR_DEPTH
	default LVGL_COLOR_DEPTH_1
endchoice

endif # LVGL

endif

config ZMK_PIMORONI_PIM447
  bool "Pimoroni PIM447 Trackball support"
  select ZMK_MOUSE
  select I2C
  select GPIO
  help
    Enable driver for Pimoroni  Trackball.

if ZMK_PIMORONI_PIM447

  config ZMK_PIMORONI_PIM447_AUTOMOUSE_TIMEOUT_MS
    int "Amount of milliseconds the mouse layer will be active after using the trackball"
    default 400

  config ZMK_PIM447_BEHAVIORS
    bool "Enable Pimoroni PIM447 Trackball Actions behavior"
    depends on ZMK_PIMORONI_PIM447
    select ZMK_BEHAVIORS
    default y
    help
      Enable Pimoroni PIM447 Trackball behaviors.

endif # ZMK_PIMORONI_PIM447
```

## config/boards/shields/eroots/Kconfig.shield
```kconfig
config SHIELD_EROOTS_LEFT
    def_bool $(shields_list_contains,eroots_left)

config SHIELD_EROOTS_RIGHT
    def_bool $(shields_list_contains,eroots_right)
    
```

## config/west.yml
```yaml
manifest:
  remotes:
    - name: zmkfirmware
      url-base: https://github.com/zmkfirmware
    - name: t0bybr
      url: https://github.com/t0bybr
    # Additional modules containing boards/shields/custom code can be listed here as well
    # See https://docs.zephyrproject.org/3.2.0/develop/west/manifest.html#projects
  projects:
    - name: zmk
      remote: zmkfirmware
      revision: main
      import: app/west.yml
    - name: pim447
      remote: t0bybr
      revision: main
  self:
    path: config
```
